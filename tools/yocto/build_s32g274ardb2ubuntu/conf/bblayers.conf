## tools/yocto/build_s32g274ardb2ubuntu/conf/bblayers.conf
```bitbake
# POKY_BBLAYERS_CONF_VERSION is increased each time build/conf/bblayers.conf
# changes incompatibly
POKY_BBLAYERS_CONF_VERSION = "2"

BBPATH = "${TOPDIR}"
BBFILES ?= ""

BBLAYERS ?= " \
  ${TOPDIR}/../sources/poky/meta \
  ${TOPDIR}/../sources/poky/meta-poky \
  ${TOPDIR}/../sources/poky/meta-yocto-bsp \
  ${TOPDIR}/../sources/meta-openembedded/meta-oe \
  ${TOPDIR}/../sources/meta-openembedded/meta-multimedia \
  ${TOPDIR}/../sources/meta-openembedded/meta-python \
  ${TOPDIR}/../sources/meta-openembedded/meta-python2 \
  ${TOPDIR}/../sources/meta-openembedded/meta-networking \
  ${TOPDIR}/../sources/meta-openembedded/meta-gnome \
  ${TOPDIR}/../sources/meta-openembedded/meta-filesystems \
  ${TOPDIR}/../sources/meta-openembedded/meta-webserver \
  ${TOPDIR}/../sources/meta-openembedded/meta-perl \
  ${TOPDIR}/../sources/meta-openembedded/meta-xfce \
  ${TOPDIR}/../sources/meta-virtualization \
  ${TOPDIR}/../sources/meta-linaro/meta-optee \
  ${TOPDIR}/../sources/meta-freescale \
  ${TOPDIR}/../sources/meta-alb \
  ${TOPDIR}/../sources/meta-aws-iot-fleetwise \
  "
```

## tools/yocto/build_s32g274ardb2ubuntu/conf/local.conf
```bitbake
MACHINE ??= 's32g274ardb2ubuntu'
DISTRO ?= 'fsl-auto'
PACKAGE_CLASSES ?= "package_rpm"
EXTRA_IMAGE_FEATURES ?= "debug-tweaks"
USER_CLASSES ?= "buildstats"
PATCHRESOLVE = "noop"
BB_DISKMON_DIRS ??= "\
    STOPTASKS,${TMPDIR},1G,100K \
    STOPTASKS,${DL_DIR},1G,100K \
    STOPTASKS,${SSTATE_DIR},1G,100K \
    STOPTASKS,/tmp,100M,100K \
    HALT,${TMPDIR},100M,1K \
    HALT,${DL_DIR},100M,1K \
    HALT,${SSTATE_DIR},100M,1K \
    HALT,/tmp,10M,1K"
PACKAGECONFIG:append_pn-qemu-system-native = " sdl"
CONF_VERSION = "2"

# Parallelism Options
BB_NUMBER_THREADS = "${@oe.utils.cpu_count()}"
PARALLEL_MAKE = "-j ${@oe.utils.cpu_count()}"
DL_DIR ?= "${TOPDIR}/../downloads"
SSTATE_DIR ?= "${TOPDIR}/../sstate-cache-ubuntu"
INHERIT += "own-mirrors"
SOURCE_MIRROR_URL ?= "http://git.freescale.com/source/"
SSTATE_MIRRORS ?= "file://.*/(.*)/(.*) file://${SSTATE_DIR}/native/\1/\2 \n"
# use xz to compress sstate
SSTATE_PKG_SUFFIX = "txz"
SSTATE_PKG_TARZIPPROG = "xz"

# Ubuntu Version
UBUNTU_TARGET_VERSION = "22.04.1"

# Additional recipes
IMAGE_INSTALL:append = " \
    can-utils \
    can-utils-access \
    can-utils-cantest \
    can-utils-isotp \
    can-utils-j1939 \
    can-utils-log \
    can-utils-slcan \
    setup-socketcan \
    "

PREFERRED_RPROVIDER_python3 = "ubuntu-base"
PREFERRED_RPROVIDER_python3-core = "ubuntu-base"
```

## tools/yocto/sources/meta-aws-iot-fleetwise/conf/layer.conf
```bitbake
# We have a conf and classes directory, add to BBPATH
BBPATH .= ":${LAYERDIR}"

# We have recipes-* directories, add to BBFILES
BBFILES += "${LAYERDIR}/recipes-*/*/*.bb \
            ${LAYERDIR}/recipes-*/*/*.bbappend"

BBFILE_COLLECTIONS += "meta-aws-iot-fleetwise"
BBFILE_PATTERN_meta-aws-iot-fleetwise = "^${LAYERDIR}/"
BBFILE_PRIORITY_meta-aws-iot-fleetwise = "7"

LAYERSERIES_COMPAT_meta-aws-iot-fleetwise = "gatesgarth"
```
