VERSION ""

NS_ :

BS_:

BU_:

BO_ 1 GPS: 8 Vector__XXX
 SG_ Longitude : 0|32@1+ (0.0000001,-200) [-200|200] "Degrees" Vector__XXX
 SG_ Latitude : 32|32@1+ (0.0000001,-200) [-200|200] "Degrees" Vector__XXX

BA_DEF_ BO_  "GenMsgCycleTime" INT 0 10000;
BA_DEF_DEF_  "GenMsgCycleTime" 0;
BA_ "GenMsgCycleTime" BO_ 1 1000;
